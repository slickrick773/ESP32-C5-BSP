## tools/startup_probe/sdkconfig.defaults
```kconfig
# ESP32-C5, stock Arduino boot layout and rollback/watchdog policy.
CONFIG_IDF_TARGET="esp32c5"
CONFIG_BOOTLOADER_OFFSET_IN_FLASH=0x2000
CONFIG_PARTITION_TABLE_OFFSET=0x8000
CONFIG_BOOTLOADER_APP_ROLLBACK_ENABLE=y
CONFIG_BOOTLOADER_WDT_ENABLE=y
CONFIG_BOOTLOADER_WDT_TIME_MS=9000
CONFIG_BOOTLOADER_SKIP_VALIDATE_IN_DEEP_SLEEP=y
CONFIG_BOOTLOADER_LOG_LEVEL_ERROR=y
CONFIG_ESPTOOLPY_FLASHMODE_QIO=y
CONFIG_ESPTOOLPY_FLASHFREQ_80M=y
CONFIG_ESPTOOLPY_FLASHSIZE_16MB=y
CONFIG_XTAL_FREQ_AUTO=y
CONFIG_ESP_CONSOLE_USB_SERIAL_JTAG=y
CONFIG_BOOTLOADER_COMPILE_TIME_DATE=n
```
